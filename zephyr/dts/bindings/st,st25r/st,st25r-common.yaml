## zephyr/dts/bindings/st,st25r/st,st25r-common.yaml
```yaml
# Copyright © 2023 Vouch.io LLC
#
# SPDX-License-Identifier: Apache-2.0

properties:
  
    irq-gpios:
      type: phandle-array
      required: true
      description: IRQ pin (active high)

    reset-gpios:
      type: phandle-array
      description: |
        Optional RESET pin. Its active level holds the IC in reset. Used by
        the ST25R500/ST25R300 driver; the ST25R3916 has no reset pin.
```
